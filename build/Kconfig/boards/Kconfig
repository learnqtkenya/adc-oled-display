## build/Kconfig/boards/Kconfig
```kconfig
# Load Zephyr board Kconfig descriptions.
osource "/home/marcus/zephyrproject/zephyr/boards/raspberrypi/rpi_pico/Kconfig"
```

## build/Kconfig/boards/Kconfig.defconfig
```kconfig
# Load Zephyr board defconfig descriptions.
osource "/home/marcus/zephyrproject/zephyr/boards/raspberrypi/rpi_pico/Kconfig.defconfig"
```

## build/Kconfig/boards/Kconfig.rpi_pico
```kconfig
# Load board Kconfig descriptions.
osource "/home/marcus/zephyrproject/zephyr/boards/raspberrypi/rpi_pico/Kconfig.rpi_pico"
```

## build/Kconfig/boards/Kconfig.sysbuild
```kconfig
# Load Sysbuild board Kconfig descriptions.
osource "/home/marcus/zephyrproject/zephyr/boards/raspberrypi/rpi_pico/Kconfig.sysbuild"
```
